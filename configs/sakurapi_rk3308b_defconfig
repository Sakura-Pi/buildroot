## configs/sakurapi_rk3308b_defconfig
```kconfig
BR2_aarch64=y
BR2_GLOBAL_PATCH_DIR="board/sakurapi/sakurapi-rk3308b"

BR2_TARGET_GENERIC_HOSTNAME="sakurapi-rk3308b"
BR2_TARGET_GENERIC_ISSUE="Welcome to Sakura Pi RK3308B"
BR2_TARGET_GENERIC_GETTY_PORT="ttyS2"
BR2_TARGET_ROOTFS_EXT2=y
BR2_TARGET_ROOTFS_EXT2_4=y
BR2_TARGET_ROOTFS_EXT2_SIZE="128M"

BR2_TARGET_UBOOT=y
BR2_TARGET_UBOOT_PATCH="$(BR2_GLOBAL_PATCH_DIR)/patches/uboot"
BR2_TARGET_UBOOT_BUILD_SYSTEM_KCONFIG=y
BR2_TARGET_UBOOT_CUSTOM_VERSION=y
BR2_TARGET_UBOOT_CUSTOM_VERSION_VALUE="2025.04"
BR2_TARGET_UBOOT_BOARD_DEFCONFIG="sakurapi_rk3308b"
BR2_TARGET_UBOOT_NEEDS_DTC=y
BR2_TARGET_UBOOT_NEEDS_PYLIBFDT=y
BR2_TARGET_UBOOT_NEEDS_ATF_BL31=y
BR2_TARGET_UBOOT_NEEDS_ATF_BL31_ELF=y
BR2_TARGET_UBOOT_FORMAT_CUSTOM=y
BR2_TARGET_UBOOT_FORMAT_CUSTOM_NAME="u-boot.itb"
BR2_TARGET_UBOOT_SPL=y
# BR2_TARGET_UBOOT_SPL_NAME="spl/u-boot-spl.bin"
BR2_TARGET_UBOOT_SPL_NAME="idbloader.img"
BR2_TARGET_UBOOT_NEEDS_ROCKCHIP_RKBIN=y
BR2_TARGET_UBOOT_NEEDS_PYELFTOOLS=y
# BR2_TARGET_UBOOT_CONFIG_FRAGMENT_FILES="$(BR2_GLOBAL_PATCH_DIR)/u-boot.fragment"

BR2_PACKAGE_ROCKCHIP_RKBIN=y
BR2_PACKAGE_ROCKCHIP_RKBIN_TPL_FILENAME="bin/rk33/rk3308_ddr_589MHz_uart2_m1_v2.10.bin"
BR2_PACKAGE_ROCKCHIP_RKBIN_BL31_FILENAME="bin/rk33/rk3308_bl31_v2.26.elf"
# BR2_PACKAGE_ROCKCHIP_RKBIN_TEE_FILENAME="bin/rk33/rk3308_bl32_v2.09.bin"
BR2_PACKAGE_HOST_GENIMAGE=y
BR2_PACKAGE_HOST_UBOOT_TOOLS=y
BR2_PACKAGE_HOST_LINUX_HEADERS_CUSTOM_6_16=y

BR2_ROOTFS_POST_BUILD_SCRIPT="board/sakurapi/sakurapi-rk3308b/post-build.sh"
BR2_ROOTFS_POST_IMAGE_SCRIPT="support/scripts/genimage.sh"
BR2_ROOTFS_POST_SCRIPT_ARGS="-c board/sakurapi/sakurapi-rk3308b/genimage.cfg"

BR2_LINUX_KERNEL=y
BR2_LINUX_KERNEL_PATCH="$(BR2_GLOBAL_PATCH_DIR)/patches/kernel"
BR2_LINUX_KERNEL_USE_CUSTOM_CONFIG=y
BR2_LINUX_KERNEL_CUSTOM_CONFIG_FILE="board/sakurapi/sakurapi-rk3308b/sakurapi_rk3308b_defconfig"
BR2_LINUX_KERNEL_CUSTOM_TARBALL=y
BR2_LINUX_KERNEL_CUSTOM_TARBALL_LOCATION="https://cdn.kernel.org/pub/linux/kernel/v6.x/linux-6.16.3.tar.xz"
BR2_LINUX_KERNEL_DTS_SUPPORT=y
BR2_LINUX_KERNEL_INTREE_DTS_NAME="rockchip/rk3308-sakurapi-rk3308b"
BR2_LINUX_KERNEL_NEEDS_HOST_OPENSSL=y
BR2_LINUX_KERNEL_NEEDS_HOST_PAHOLE=y
BR2_LINUX_KERNEL_IMAGE=y
BR2_LINUX_KERNEL_INSTALL_TARGET=y
```
